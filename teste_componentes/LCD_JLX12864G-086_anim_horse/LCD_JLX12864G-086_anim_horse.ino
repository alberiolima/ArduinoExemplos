/*******************************************************************************
 * Project  : Animation Horse Test                                             *
 * Compiler : Arduino 1.5.2                                                    *
 * Board    : Arduino Nano 3.0                                                 *
 *                                                                             *
 * Module   : [JLX12864G-086] Graphic LCD 128x64                               *
 *          :                                                                  *
 * Remark   : Use PROGMEM for Bitmap array                                     *
 *                                                                             *
 * Author   : Mr.Thongchai Artsamart [BIRD TECHSTEP]                           *
 * E-Mail   : tbird_th@hotmail.com                                             *
 * Date     : 30/08/2012 [dd/mm/yyyy]                                          *
 *******************************************************************************/
#include <SPI.h>
#include <avr/pgmspace.h>

const static unsigned char horse0[] PROGMEM = {
0x00, 0x00, 0x00, 0x00, 0x00, 0x00, 0x00, 0x00, 0x00, 0x00, 0x00, 0x00, 0x00, 0x00, 0x00, 0x00, 
0x00, 0x00, 0x00, 0x00, 0x00, 0x00, 0x00, 0x00, 0x00, 0x00, 0x00, 0x00, 0x00, 0x00, 0x00, 0x00, 
0x00, 0x00, 0x00, 0x00, 0x00, 0x00, 0x00, 0x00, 0x00, 0x00, 0x00, 0x00, 0x00, 0x00, 0x00, 0x00, 
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0x00, 0x00, 0x00, 0x00, 0x00, 0x00, 0x00, 0x00, 0x00, 0x00, 0x00, 0x00, 0x00, 0x00, 0x00, 0x00

};

const static unsigned char horse1[] PROGMEM = {
0x00, 0x00, 0x00, 0x00, 0x00, 0x00, 0x00, 0x00, 0x00, 0x00, 0x00, 0x00, 0x00, 0x00, 0x00, 0x00, 
0x00, 0x00, 0x00, 0x00, 0x00, 0x00, 0x00, 0x00, 0x00, 0x00, 0x00, 0x00, 0x00, 0x00, 0x00, 0x00, 
0x00, 0x00, 0x00, 0x00, 0x00, 0x00, 0x00, 0x00, 0x00, 0x00, 0x00, 0x00, 0x00, 0x00, 0x00, 0x00, 
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0x00, 0x00, 0x00, 0x00, 0x00, 0x00, 0x00, 0x00, 0x00, 0x00, 0x00, 0x00, 0x00, 0x00, 0x00, 0x00, 

};

const static unsigned char horse2[] PROGMEM = {
0x00, 0x00, 0x00, 0x00, 0x00, 0x00, 0x00, 0x00, 0x00, 0x00, 0x00, 0x00, 0x00, 0x00, 0x00, 0x00, 
0x00, 0x00, 0x00, 0x00, 0x00, 0x00, 0x00, 0x00, 0x00, 0x00, 0x00, 0x00, 0x00, 0x00, 0x00, 0x00, 
0x00, 0x00, 0x00, 0x00, 0x00, 0x00, 0x00, 0x00, 0x00, 0x00, 0x00, 0x00, 0x00, 0x00, 0x00, 0x00, 
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0x00, 0x00, 0x00, 0x00, 0x00, 0x00, 0x00, 0x00, 0x00, 0x00, 0x00, 0x00, 0x00, 0x00, 0x00, 0x00, 

};

const static unsigned char horse3[] PROGMEM = {
0x00, 0x00, 0x00, 0x00, 0x00, 0x00, 0x00, 0x00, 0x00, 0x00, 0x00, 0x00, 0x00, 0x00, 0x00, 0x00, 
0x00, 0x00, 0x00, 0x00, 0x00, 0x00, 0x00, 0x00, 0x00, 0x00, 0x00, 0x00, 0x00, 0x00, 0x00, 0x00, 
0x00, 0x00, 0x00, 0x00, 0x00, 0x00, 0x00, 0x00, 0x00, 0x00, 0x00, 0x00, 0x00, 0x00, 0x00, 0x00, 
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0x00, 0x00, 0x00, 0x00, 0x00, 0x00, 0x00, 0x00, 0x00, 0x00, 0x00, 0x00, 0x00, 0x00, 0x00, 0x00, 

};

const static unsigned char horse4[] PROGMEM = {
0x00, 0x00, 0x00, 0x00, 0x00, 0x00, 0x00, 0x00, 0x00, 0x00, 0x00, 0x00, 0x00, 0x00, 0x00, 0x00, 
0x00, 0x00, 0x00, 0x00, 0x00, 0x00, 0x00, 0x00, 0x00, 0x00, 0x00, 0x00, 0x00, 0x00, 0x00, 0x00, 
0x00, 0x00, 0x00, 0x00, 0x00, 0x00, 0x00, 0x00, 0x00, 0x00, 0x00, 0x00, 0x00, 0x00, 0x00, 0x00, 
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0x00, 0x00, 0x00, 0x00, 0x00, 0x00, 0x00, 0x00, 0x00, 0x00, 0x00, 0x00, 0x00, 0x00, 0x00, 0x00, 

};

const static unsigned char horse5[] PROGMEM = {
0x00, 0x00, 0x00, 0x00, 0x00, 0x00, 0x00, 0x00, 0x00, 0x00, 0x00, 0x00, 0x00, 0x00, 0x00, 0x00, 
0x00, 0x00, 0x00, 0x00, 0x00, 0x00, 0x00, 0x00, 0x00, 0x00, 0x00, 0x00, 0x00, 0x00, 0x00, 0x00, 
0x00, 0x00, 0x00, 0x00, 0x00, 0x00, 0x00, 0x00, 0x00, 0x00, 0x00, 0x00, 0x00, 0x00, 0x00, 0x00, 
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0x00, 0x00, 0x00, 0x00, 0x00, 0x00, 0x00, 0x00, 0x00, 0x00, 0x00, 0x00, 0x00, 0x00, 0x00, 0x00, 

};

const static unsigned char horse6[] PROGMEM = {
0x00, 0x00, 0x00, 0x00, 0x00, 0x00, 0x00, 0x00, 0x00, 0x00, 0x00, 0x00, 0x00, 0x00, 0x00, 0x00, 
0x00, 0x00, 0x00, 0x00, 0x00, 0x00, 0x00, 0x00, 0x00, 0x00, 0x00, 0x00, 0x00, 0x00, 0x00, 0x00, 
0x00, 0x00, 0x00, 0x00, 0x00, 0x00, 0x00, 0x00, 0x00, 0x00, 0x00, 0x00, 0x00, 0x00, 0x00, 0x00, 
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0x00, 0x00, 0x00, 0x00, 0x00, 0x00, 0x00, 0x00, 0x00, 0x00, 0x00, 0x00, 0x00, 0x00, 0x00, 0x00, 

};

const static unsigned char horse7[] PROGMEM = {
0x00, 0x00, 0x00, 0x00, 0x00, 0x00, 0x00, 0x00, 0x00, 0x00, 0x00, 0x00, 0x00, 0x00, 0x00, 0x00, 
0x00, 0x00, 0x00, 0x00, 0x00, 0x00, 0x00, 0x00, 0x00, 0x00, 0x00, 0x00, 0x00, 0x00, 0x00, 0x00, 
0x00, 0x00, 0x00, 0x00, 0x00, 0x00, 0x00, 0x00, 0x00, 0x00, 0x00, 0x00, 0x00, 0x00, 0x00, 0x00, 
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0x00, 0x00, 0x00, 0x00, 0x00, 0x00, 0x00, 0x00, 0x00, 0x00, 0x00, 0x00, 0x00, 0x00, 0x00, 0x00, 

};

/*
horse0[]     | Array : 1024 | Height: 64  Width: 128
horse1[]     | Array : 1024 | Height: 64  Width: 128
horse2[]     | Array : 1024 | Height: 64  Width: 128
horse3[]     | Array : 1024 | Height: 64  Width: 128
horse4[]     | Array : 1024 | Height: 64  Width: 128
horse5[]     | Array : 1024 | Height: 64  Width: 128
horse6[]     | Array : 1024 | Height: 64  Width: 128
horse7[]     | Array : 1024 | Height: 64  Width: 128
*/

/*---------------------------------------------------------------------------
 | JLX12864G-086 (Graphic LCD 128x64)                                        |
 |---------------------------------------------------------------------------|
 | Pin Connect :                                                             |
 |          CS : 8         VDD : 3v3                                         |
 |         RST : 9         VSS : GND                                         |
 |          RS : 10       LEDA : 5v                                          |
 |         SDA : 11                                                          |
 |         SCK : 13                                                          |
  ---------------------------------------------------------------------------*/
#define   csPIN  8   // CS
#define  rstPIN  9   // RST
#define   rsPIN 10   // RS
#define  sdaPIN 11   // SDA
#define  sckPIN 13   // SCK
#define LEDAPIN  7   // LEDA Pin Backlight ON/OFF R pulldown with Transistor OUTPUT

unsigned int frame;
/*---------------------------------------------------------------------------
 | Function Design                                                           |
  ---------------------------------------------------------------------------*/
void sendCommand(int data1);
void sendData(int data1);
void Initial_Lcd();
void gotoXY(int x, int y);
void clear_screen();
void AnimHorse(unsigned int frame);

void setup() {

  pinMode(LEDAPIN, OUTPUT);
  digitalWrite(LEDAPIN, 0); // LEDA Backlight OFF

  // initialize SPI:
  SPI.begin(); 
  
  Initial_Lcd();
  clear_screen();
  digitalWrite(LEDAPIN, 1); // LEDA Backlight ON
}

void loop() {
  for (int i=0;i<8;i++)
  {
    AnimHorse(i);
    delay(80); // 1000/12.5 frame late
  }
}

void sendCommand(int data1)
{
  digitalWrite(csPIN, 0);
  digitalWrite(rsPIN, 0);
  SPI.transfer(data1);
  digitalWrite(csPIN, 1);
}

void sendData(int data1)
{
  digitalWrite(csPIN, 0);
  digitalWrite(rsPIN, 1);
  SPI.transfer(data1);
  digitalWrite(csPIN, 1);
}

void Initial_Lcd()
{
  pinMode(csPIN,   OUTPUT);
  pinMode(rstPIN,  OUTPUT);
  pinMode(rsPIN,   OUTPUT);
  pinMode(sckPIN,  OUTPUT);
  pinMode(sdaPIN,  OUTPUT);

  digitalWrite(rstPIN, 0); // Reset the chip when reset = 0
  delayMicroseconds(50);
  digitalWrite(rstPIN, 1);
  delayMicroseconds(50);
  sendCommand(0xE2); // Soft Reset
  sendCommand(0x2C); // Boost 1
  sendCommand(0x2E); // Boost 2
  sendCommand(0x2F); // Boost 3
  sendCommand(0x23); // Coarse Contrast, setting range is from 20 to 27
  sendCommand(0x81); // Trim Contrast
  sendCommand(0x28); // Trim Contrast value range can be set from 0 to 63
  sendCommand(0xA2); // 1/9 bias ratio (1/7 bias ratio [0xA3])
  sendCommand(0xC8); // Line scan sequence : from top to bottom
  sendCommand(0xA0); // Column scanning order : from left to right
  sendCommand(0xAF); // Open the display
}

void gotoXY(int x, int y)
{ // y with Page 0 - 8 x = 0 - 127
  sendCommand(0xB0+y);
  sendCommand(0x10+(x/16));
  sendCommand(0x00+(x%16));  
}

//===============clear all dot martrics=============
void clear_screen()
{
  unsigned char i,j;
  for(i=0;i<9;i++)
  {
    gotoXY(0, i);
    for(j=0;j<132;j++)
    {
      sendData(0x00);
    }
  }
}


//==================display a picture of 128*64 dots================
void AnimHorse(unsigned int frame)
{  
  unsigned char i, j;
  int k = 0;
  for(i=0;i<8;i++)
  {
    gotoXY(0, i);
    for(j=0;j<128;j++)
    {
      switch (frame) {
    case 1:
      sendData(pgm_read_byte(&horse1[k]));
      break;
    case 2:
      sendData(pgm_read_byte(&horse2[k]));
      break;
    case 3:
      sendData(pgm_read_byte(&horse3[k]));
      break;
    case 4:
      sendData(pgm_read_byte(&horse4[k]));
      break;
    case 5:
      sendData(pgm_read_byte(&horse5[k]));
      break;
    case 6:
      sendData(pgm_read_byte(&horse6[k]));
      break;
    case 7:
      sendData(pgm_read_byte(&horse7[k]));
      break;
    default: 
      sendData(pgm_read_byte(&horse0[k]));
      break;
      }
      k++;
    }
  }
}

